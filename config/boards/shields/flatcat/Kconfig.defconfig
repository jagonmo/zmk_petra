## config/boards/shields/flatcat/Kconfig.shield
```kconfig
config SHIELD_FLATCAT_DONGLE
    def_bool $(shields_list_contains,flatcat_dongle)

config SHIELD_FLATCAT
    def_bool $(shields_list_contains,flatcat)
    
config SHIELD_FLATCAT_PERIPHERAL
    def_bool $(shields_list_contains,flatcat_peripheral)
```
