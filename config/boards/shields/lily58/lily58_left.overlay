/*
 * Copyright (c) 2020 Pete Johanson
 *
 * SPDX-License-Identifier: MIT
 */
/*
 * Copyright (c) 2020 Pete Johanson
 *
 * SPDX-License-Identifier: MIT
 */
 #include "lily58.dtsi"

 &default_transform {
     col-offset = <14>;
 };
 
 &default_keyscan {
     col-gpios
         = <&gpio1 6  GPIO_ACTIVE_HIGH>
         ;
 };